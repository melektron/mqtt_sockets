#include <ESP8266WiFi.h>
#include <ESP8266mDNS.h>
#include <PubSubClient.h>
#include <RCSwitch.h>


// COMMENT added at 230401: The following certificates are invalid. They have never been used and have been scrambled before publishing to github and are only present to preserve the orinal shape of the code

// ca file converted to c++ array by python programm "ca2cpp_array.py"
//unsigned char root_ca[] = {0x2, 0x95, 0xa0, 0x3, 0x2, 0x1, 0x2, 0x2, 0x9b, 0x37, 0x5b, 0x4c, 0xe9,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 0x82, 0xf10x30, 0x82, 0x3, 0xad, 0x14, 0x7a, 0xd, 0xe3, 0x5, 0xd, 0x98, 0x1e, 0xff, 0x17, 0x30, 0x82, 0xeb, 0x2f, 0x4b, 0xc7, 0x13, 0x30, 0xd};


/*const char* test_root_ca = \ 
"-----BEGIN CERTIFICATE-----\n" \ 
"h2c95bL/Dg49CvySfKp98TpdwIS8zKtxZy11q5HVT3OEzeZfu2J5aWzbeVmT20Pg\n" \ 
"YGrDX4sWDFxb7kWx1/e8SJ/LSu0+iNmZ6gyuXiDAiJMa29rOSqg/EGRGK9mt3IOU\n" \ 
"MIIDrTCCApWgAwIBAgIUeg3jBQ2YHv8XmzdbTOk36y9LxxMwDQYJKoZIhvcNAQEN\n" \ 
"eGFtcGxlLm5ldDAeFw0yMDExMjQyMTIzMTBaFw0zMjExMjEyMTIzMTBaMGYxDjAM\n" \ 
"BgNVBAMMBXJwaTNiMRYwFAYDVQQKDA1lbGVrdHJvbi53b3JrMRYwFAYDVQQLDA1N\n" \ 
"UVRUX1NlcnZpY2VzMSQwIgYJKoZIhvcNAQkBFhVzb21ldGhpbmdAZXhhbXBsZS5u\n" \ 
"ZXQwggEiMA0GCSqGSIb3DQEBAQUAA4IBDwAwggEKAoIBAQDjSHry6gkLmXMuCffP\n" \ 
"BQAwZjEOMAwGA1UEAwwFcnBpM2IxFjAUBgNVBAoMDWVsZWt0cm9uLndvcmsxFjAU\n" \ 
"BgNVBAsMDU1RVFRfU2VydmljZXMxJDAiBgkqhkiG9w0BCQEWFXNvbWV0aGluZ0Bl\n" \ 
"Ve3f8/Xd8nefLMcKzle7TFkQGz//KzIhldCisCaZrtXwbM7s4a/T7knjGBEdzfBL\n" \ 
"Ua9f5wA8kVm7fc+p9yVSZEV70PAmdcXpG4lQxrw5wRqcG3pWlag67bHmAClv20VN\n" \ 
"TQ+Of+Y8vt6TNHarS8NA2TmE4jH4kC9ABj/PNRH+SJfRjGCTiKw8KaxLoT89h0oV\n" \ 
"asd84GoU0PcWfvrRTG6sF7rN1K5Ow+T79IQHN3NYxRZFQMytleVpe0lsYk8lGgbk\n" \ 
"F0T+Q89VZQFLagrdTFTlPmfyZPSgO3qZ1mbV+KYlAfRJ79RIla7EX/rvIYJN1ZRM\n" \ 
"7SUbAgMBAAGjUzBRMB0GA1UdDgQWBBR3i6J26ve0IDYjTfW5pox2F2xavzAfBgNV\n" \ 
"HSMEGDAWgBR3i6J26ve0IDYjTfW5pox2F2xavzAPBgNVHRMBAf8EBTADAQH/MA0G\n" \ 
"sBXwASWak3YfeTHe4TpzuvIsacmjAif52BaB7R3+e20IVwcewzgHP9gX2cZ1DwdV\n" \ 
"CSqGSIb3DQEBDQUAA4IBAQCOkL2Tlwusn3EschqdzquKQf5PDduq66MWKGWCSE6M\n" \ 
"IEt5dHBhH5LWXX8wpiR1ScyLyppxka/zK5BKpKbq/3ZUP+K2a9NlZRhqNgA6J/bU\n" \ 
"cqfD1+JWeyUfF/a5M9WW4HnU/ZezJHbtxAdGtINOUYLx\n" \ 
"-----END CERTIFICATE-----\n" ;
*/

int rctx = 2;
int rcrx = 0;

// WIFI data has been censored for publication
const char* cfg_wifi_ssid = "********";
const char* cfg_wifi_pwd = "********";

const char* mqtt_server = "192.168.1.13";
const unsigned int mqtt_port = 1883;
const char* mqtt_user =   "****";
const char* mqtt_pass =   "****";
char systemCode[] = "00000";
char unitCode[] = "00000";
char stateCode = '0';
bool messageInvalid = false;

//echo | openssl s_client -connect localhost:1883 | openssl x509 -fingerprint -noout
const char* mqtt_fprint = "07 ED 59 67 2C CD 31 6C EF 27 F7 AC 38 02 07 9C 60 EC FA 0A";


IPAddress ip(192,168,1,92); //Requested static IP address for the ESP
IPAddress router(192,168,1,1); // IP address for the Wifi router
IPAddress netmask(255,255,255,0);


//WiFiClient wifiClient;
WiFiClientSecure espClient;
PubSubClient client(espClient);

RCSwitch mySwitch = RCSwitch();

int WiFiConnected = 0;

void setup() {
  // put your setup code here, to run once:
  //delay(5000);
  espClient.setInsecure();

  Serial.begin(115200);
  pinMode(WiFiConnected, OUTPUT);
  mySwitch.enableTransmit(rctx);
  Serial.println("TestMQTT");
  // set up wifi config
  WiFi.mode(WIFI_STA);
  WiFi.config(ip,router,netmask);
  WiFi.begin(cfg_wifi_ssid, cfg_wifi_pwd);
  // wait until wifi is connected
  while (WiFi.status() != WL_CONNECTED) {
    delay(500);
    Serial.print(".");
    digitalWrite(WiFiConnected, !digitalRead(WiFiConnected));
  }

  Serial.println("");
  digitalWrite(WiFiConnected, HIGH);
  Serial.println("WiFi connected");
  Serial.println("IP address: ");
  Serial.println(WiFi.localIP());
  Serial.println("MAC Address:");
  Serial.println(WiFi.macAddress());
  // set the ca certificate
  //espClient.setCACert(test_root_ca);
  
  // set MQTT server and callback function
  client.setServer(mqtt_server, mqtt_port);
  client.setCallback(callback);
  // attempting to connect to the server
  while (!client.connected()) {
    Serial.print("Attempting MQTT connection...");
    verifyFingerprint();
    if (client.connect(mqtt_user, mqtt_user, mqtt_pass)) {
      Serial.println("connected");
      client.subscribe("/devices/sub0/espdev2048a/remote_switches/dip");
    }else{
      Serial.print("failed, rc=");
      Serial.print(client.state());
      Serial.println(" try again in 5 seconds");
      // Wait 5 seconds before retrying
      delay(5000);
    }
  }
}

void callback(char* topic, byte* payload, unsigned int length) {
  Serial.print("Message arrived [");
  Serial.print(topic);
  Serial.print("] ");

  char message[length + 1];
  for (int i = 0; i < length; i++) {
    message[i] = (char)payload[i];
  }
  message[length] = '\0';
  Serial.println(message);
  for (int i = 0; i < length; i++){
    Serial.print(message[i]);
    if (message[i] != '0'){
      if (message[i] != '1'){
        Serial.println();
        Serial.print("Message invalid: message[");
        Serial.print(i);
        Serial.print("] == ");
        Serial.print(message[i]);
        Serial.print(" ==> \"");
        Serial.print(message[i]);
        Serial.println("\" is not 0 or 1");
        messageInvalid = true;
        break;
      }
    }
  }
  if (messageInvalid != true){
    /*
    for ( int i = 0; i > 5; i++){
      systemCode[i] = message[i];
    }
    for ( int i = 5; i > 10; i++){
      unitCode[i - 5] = message[i];
    }
    */
    systemCode[0] = message[0];
    systemCode[1] = message[1];
    systemCode[2] = message[2];
    systemCode[3] = message[3];
    systemCode[4] = message[4];
    unitCode[0] = message[5];
    unitCode[1] = message[6];
    unitCode[2] = message[7];
    unitCode[3] = message[8];
    unitCode[4] = message[9];
    
    stateCode = message[10];
    if (stateCode == '1'){
      mySwitch.switchOn(systemCode, unitCode);
      Serial.println("Switched on:");
    }else if(stateCode == '0'){
      mySwitch.switchOff(systemCode, unitCode);
      Serial.println("Switched off:");
    }
    //Serial.println("Switched:");
    Serial.print("SystemCode: ");
    Serial.println(systemCode);
    Serial.print("UnitCode;   ");
    Serial.println(unitCode);
    Serial.print("StateCode:  ");
    //Serial.println(stateCode);
  }else{
    messageInvalid = false;
  }
}

void verifyFingerprint() {
  if(client.connected() || espClient.connected()) return; //Already connected
  
  Serial.print("Checking TLS @ ");
  Serial.print(mqtt_server);
  Serial.print("...");
  
  if (!espClient.connect(mqtt_server, mqtt_port)) {
    Serial.println("Connection failed. Rebooting.");
    Serial.flush();
    ESP.restart();
  }
  /*
  if (espClient.verify(mqtt_fprint, mqtt_server)) {
    Serial.print("Connection secure -> .");
  } else {
    Serial.println("Connection insecure! Rebooting.");
    Serial.flush();
    ESP.restart(); 
  }
  */
  espClient.stop();

  delay(100);
}

unsigned int counter = 0;

void loop() {
  // put your main code here, to run repeatedly:
  client.loop();
  //delay(100);
}
